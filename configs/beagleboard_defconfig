## configs/bf527-ezkit-fdpic_defconfig
```kconfig
BR2_bfin=y
BR2_bf527=y
BR2_GCC_TARGET_CPU_REVISION="0.0"
BR2_BINFMT_FDPIC=y
# BR2_BFIN_INSTALL_FLAT_SHARED is not set
BR2_DEPRECATED=y
BR2_TOOLCHAIN_EXTERNAL=y
BR2_TOOLCHAIN_EXTERNAL_CUSTOM=y
BR2_TOOLCHAIN_EXTERNAL_PATH=""
BR2_TOOLCHAIN_EXTERNAL_CUSTOM_PREFIX="bfin-linux-uclibc"
BR2_TOOLCHAIN_EXTERNAL_LARGEFILE=y
BR2_TOOLCHAIN_EXTERNAL_INET_RPC=y
BR2_TOOLCHAIN_EXTERNAL_CXX=y
BR2_TOOLCHAIN_EXTRA_EXTERNAL_LIBS="libgfortran.so libgomp.so libmudflap.so libmudflapth.so libobjc.so"
BR2_PACKAGE_GDB_SERVER=y
BR2_ROOTFS_DEVICE_CREATION_DYNAMIC_MDEV=y
BR2_ROOTFS_DEVICE_TABLE="board/AnalogDevices/blackfin/device_table-min.txt"
BR2_ROOTFS_SKELETON_CUSTOM=y
BR2_ROOTFS_SKELETON_CUSTOM_PATH="board/AnalogDevices/blackfin/target_skeleton"
BR2_PACKAGE_BUSYBOX_CONFIG="board/AnalogDevices/blackfin/busybox-fdpic.config"
BR2_PACKAGE_BUSYBOX_SHOW_OTHERS=y
BR2_PACKAGE_ALSA_UTILS=y
BR2_PACKAGE_ALSA_UTILS_AMIXER=y
BR2_PACKAGE_ALSA_UTILS_APLAY=y
BR2_PACKAGE_ALSA_UTILS_SPEAKER_TEST=y
BR2_PACKAGE_FFMPEG=y
BR2_PACKAGE_FFMPEG_FFPLAY=y
BR2_PACKAGE_FFMPEG_FFSERVER=y
BR2_PACKAGE_DHRYSTONE=y
BR2_PACKAGE_NBENCH=y
BR2_PACKAGE_STRACE=y
BR2_PACKAGE_WHETSTONE=y
BR2_PACKAGE_MTD=y
BR2_PACKAGE_LIBAO=y
BR2_PACKAGE_LIBID3TAG=y
BR2_PACKAGE_LIBMAD=y
BR2_PACKAGE_LIBVORBIS=y
BR2_PACKAGE_SPEEX=y
BR2_PACKAGE_LIBGCRYPT=y
BR2_PACKAGE_SQLITE=y
BR2_PACKAGE_JPEG=y
BR2_PACKAGE_LIBPNG=y
BR2_PACKAGE_VERSION=y
BR2_PACKAGE_INETUTILS=y
BR2_TARGET_ROOTFS_EXT2=y
BR2_TARGET_ROOTFS_JFFS2=y
BR2_TARGET_ROOTFS_UBIFS=y
# BR2_TARGET_ROOTFS_TAR is not set
BR2_TARGET_ROOTFS_INITRAMFS=y
BR2_LINUX_KERNEL=y
BR2_LINUX_KERNEL_CUSTOM_OVERRIDE=y
BR2_LINUX_KERNEL_CUSTOM_OVERRIDE_PATH="linux/linux-kernel"
BR2_LINUX_KERNEL_PATCH="board/AnalogDevices/blackfin/patches/linux-3.8/"
BR2_LINUX_KERNEL_DEFCONFIG="BF527-EZKIT"
```

## configs/bf527-ezkit-v2_defconfig
```kconfig
BR2_bfin=y
BR2_bf527=y
BR2_GCC_TARGET_CPU_REVISION="0.2"
BR2_BINFMT_FLAT=y
# BR2_BFIN_INSTALL_FDPIC_SHARED is not set
# BR2_BFIN_INSTALL_FLAT_SHARED is not set
BR2_DEPRECATED=y
BR2_TOOLCHAIN_EXTERNAL=y
BR2_TOOLCHAIN_EXTERNAL_CUSTOM=y
BR2_TOOLCHAIN_EXTERNAL_PATH=""
BR2_TOOLCHAIN_EXTERNAL_CUSTOM_PREFIX="bfin-uclinux"
BR2_TOOLCHAIN_EXTERNAL_LARGEFILE=y
BR2_TOOLCHAIN_EXTERNAL_INET_RPC=y
BR2_TOOLCHAIN_EXTERNAL_CXX=y
BR2_TOOLCHAIN_EXTRA_EXTERNAL_LIBS="libgfortran.so libgomp.so libmudflap.so libmudflapth.so libobjc.so"
BR2_PACKAGE_GDB_SERVER=y
BR2_ROOTFS_DEVICE_CREATION_DYNAMIC_MDEV=y
BR2_ROOTFS_DEVICE_TABLE="board/AnalogDevices/blackfin/device_table-min.txt"
BR2_ROOTFS_SKELETON_CUSTOM=y
BR2_ROOTFS_SKELETON_CUSTOM_PATH="board/AnalogDevices/blackfin/target_skeleton"
BR2_PACKAGE_BUSYBOX_CONFIG="board/AnalogDevices/blackfin/busybox-flat.config"
BR2_PACKAGE_BUSYBOX_SHOW_OTHERS=y
BR2_PACKAGE_DHRYSTONE=y
BR2_PACKAGE_NBENCH=y
BR2_PACKAGE_STRACE=y
BR2_PACKAGE_WHETSTONE=y
BR2_PACKAGE_MTD=y
BR2_PACKAGE_LIBGCRYPT=y
BR2_PACKAGE_SQLITE=y
BR2_PACKAGE_JPEG=y
BR2_PACKAGE_LIBPNG=y
BR2_PACKAGE_VERSION=y
BR2_PACKAGE_INETUTILS=y
BR2_TARGET_ROOTFS_EXT2=y
BR2_TARGET_ROOTFS_JFFS2=y
BR2_TARGET_ROOTFS_UBIFS=y
# BR2_TARGET_ROOTFS_TAR is not set
BR2_TARGET_ROOTFS_INITRAMFS=y
BR2_LINUX_KERNEL=y
BR2_LINUX_KERNEL_CUSTOM_OVERRIDE=y
BR2_LINUX_KERNEL_CUSTOM_OVERRIDE_PATH="linux/linux-kernel"
BR2_LINUX_KERNEL_PATCH="board/AnalogDevices/blackfin/patches/linux-3.8/"
BR2_LINUX_KERNEL_DEFCONFIG="BF527-EZKIT-V2"
```

## configs/bf538-ezkit_defconfig
```kconfig
BR2_bfin=y
BR2_BFIN_FLAT=y
BR2_bf538=y
# BR2_BFIN_INSTALL_ELF_SHARED is not set
# BR2_BFIN_INSTALL_FLAT_SHARED is not set
BR2_GCC_TARGET_CPU_REVISION="0.4"
BR2_DEPRECATED=y
BR2_TOOLCHAIN_EXTERNAL=y
BR2_TOOLCHAIN_EXTERNAL_CUSTOM=y
BR2_TOOLCHAIN_EXTERNAL_PATH=""
BR2_TOOLCHAIN_EXTERNAL_CUSTOM_PREFIX="bfin-uclinux"
BR2_TOOLCHAIN_EXTERNAL_LARGEFILE=y
BR2_TOOLCHAIN_EXTERNAL_INET_RPC=y
BR2_TOOLCHAIN_EXTERNAL_CXX=y
BR2_PACKAGE_GDB_SERVER=y
BR2_ROOTFS_DEVICE_CREATION_DYNAMIC_MDEV=y
BR2_ROOTFS_DEVICE_TABLE="board/AnalogDevices/blackfin/device_table-min.txt"
BR2_ROOTFS_SKELETON_CUSTOM=y
BR2_ROOTFS_SKELETON_CUSTOM_PATH="board/AnalogDevices/blackfin/target_skeleton"
BR2_PACKAGE_BUSYBOX_CONFIG="board/AnalogDevices/blackfin/busybox-flat.config"
BR2_PACKAGE_BUSYBOX_SHOW_OTHERS=y
BR2_PACKAGE_DHRYSTONE=y
BR2_PACKAGE_NBENCH=y
BR2_PACKAGE_STRACE=y
BR2_PACKAGE_WHETSTONE=y
BR2_PACKAGE_MTD=y
BR2_PACKAGE_LIBGCRYPT=y
BR2_PACKAGE_SQLITE=y
BR2_PACKAGE_JPEG=y
BR2_PACKAGE_LIBPNG=y
BR2_PACKAGE_VERSION=y
BR2_PACKAGE_INETUTILS=y
BR2_TARGET_ROOTFS_EXT2=y
BR2_TARGET_ROOTFS_JFFS2=y
BR2_TARGET_ROOTFS_UBIFS=y
# BR2_TARGET_ROOTFS_TAR is not set
BR2_TARGET_ROOTFS_INITRAMFS=y
BR2_LINUX_KERNEL=y
BR2_LINUX_KERNEL_CUSTOM_OVERRIDE=y
BR2_LINUX_KERNEL_CUSTOM_OVERRIDE_PATH="linux/linux-kernel"
BR2_LINUX_KERNEL_PATCH="board/AnalogDevices/blackfin/patches/linux-3.5/"
BR2_LINUX_KERNEL_DEFCONFIG="BF538-EZKIT"
```

## configs/bf609-ezkit-flat_defconfig
```kconfig
BR2_bfin=y
BR2_BFIN_FLAT=y
BR2_GCC_TARGET_CPU_REVISION="0.0"
BR2_SOURCEFORGE_MIRROR="easynews"
BR2_DEPRECATED=y
BR2_TOOLCHAIN_EXTERNAL=y
BR2_TOOLCHAIN_EXTERNAL_CUSTOM=y
BR2_TOOLCHAIN_EXTERNAL_PATH=""
BR2_TOOLCHAIN_EXTERNAL_CUSTOM_PREFIX="bfin-uclinux"
BR2_TOOLCHAIN_EXTERNAL_LARGEFILE=y
BR2_TOOLCHAIN_EXTERNAL_INET_RPC=y
BR2_TOOLCHAIN_EXTERNAL_CXX=y
BR2_PACKAGE_GDB_SERVER=y
BR2_ROOTFS_DEVICE_CREATION_DYNAMIC_MDEV=y
BR2_ROOTFS_DEVICE_TABLE="board/AnalogDevices/blackfin/device_table-min.txt"
BR2_ROOTFS_SKELETON_CUSTOM=y
BR2_ROOTFS_SKELETON_CUSTOM_PATH="board/AnalogDevices/blackfin/target_skeleton"
BR2_BUSYBOX_VERSION_1_18_X=y
BR2_PACKAGE_BUSYBOX_CONFIG="board/AnalogDevices/blackfin/busybox.config"
BR2_PACKAGE_BUSYBOX_SHOW_OTHERS=y
BR2_PACKAGE_DHRYSTONE=y
BR2_PACKAGE_NBENCH=y
BR2_PACKAGE_STRACE=y
BR2_PACKAGE_WHETSTONE=y
BR2_PACKAGE_MTD=y
BR2_PACKAGE_LIBAO=y
BR2_PACKAGE_LIBID3TAG=y
BR2_PACKAGE_LIBMAD=y
BR2_PACKAGE_LIBVORBIS=y
BR2_PACKAGE_SPEEX=y
BR2_PACKAGE_LIBGCRYPT=y
BR2_PACKAGE_SQLITE=y
BR2_PACKAGE_JPEG=y
BR2_PACKAGE_LIBPNG=y
BR2_PACKAGE_READLINE=y
BR2_PACKAGE_BFIN_DMA=y
BR2_PACKAGE_EVENT_TEST=y
BR2_PACKAGE_VERSION=y
BR2_PACKAGE_INETUTILS=y
BR2_TARGET_ROOTFS_EXT2=y
BR2_TARGET_ROOTFS_JFFS2=y
BR2_TARGET_ROOTFS_UBIFS=y
# BR2_TARGET_ROOTFS_TAR is not set
BR2_TARGET_ROOTFS_INITRAMFS=y
BR2_LINUX_KERNEL=y
BR2_LINUX_KERNEL_CUSTOM_OVERRIDE=y
BR2_LINUX_KERNEL_CUSTOM_OVERRIDE_PATH="linux/linux-kernel"
BR2_LINUX_KERNEL_PATCH="board/AnalogDevices/blackfin/patches/linux-3.5/"
BR2_LINUX_KERNEL_DEFCONFIG="BF609-EZKIT"
```

## configs/bf609-ezkit_defconfig
```kconfig
BR2_bfin=y
BR2_BFIN_FDPIC=y
BR2_SOURCEFORGE_MIRROR="easynews"
BR2_TOOLCHAIN_EXTERNAL=y
# BR2_TOOLCHAIN_OVERRIDE_VENDOR is not set
BR2_TOOLCHAIN_EXTERNAL_LARGEFILE=y
BR2_TOOLCHAIN_EXTERNAL_INET_RPC=y
BR2_TOOLCHAIN_EXTERNAL_PROGRAM_INVOCATION=y
BR2_TOOLCHAIN_EXTERNAL_HAS_THREADS=y
BR2_TOOLCHAIN_EXTERNAL_CXX=y
BR2_PACKAGE_GDB_SERVER=y
BR2_TARGET_ANALOGDEVICES=y
BR2_ROOTFS_DEVICE_TABLE="target/device/AnalogDevices/device_table-min.txt"
BR2_ROOTFS_SKELETON_CUSTOM=y
BR2_ROOTFS_SKELETON_CUSTOM_PATH=""
BR2_BUSYBOX_VERSION_1_17_X=y
BR2_PACKAGE_BUSYBOX_CONFIG=""
BR2_PACKAGE_CUSTOMIZE=y
BR2_PACKAGE_FFMPEG=y
BR2_PACKAGE_FFMPEG_FFPLAY=y
BR2_PACKAGE_FFMPEG_FFSERVER=y
BR2_PACKAGE_LIBAO=y
BR2_PACKAGE_LIBID3TAG=y
BR2_PACKAGE_LIBMAD=y
BR2_PACKAGE_LIBVORBIS=y
BR2_PACKAGE_SPEEX=y
BR2_PACKAGE_BONNIE=y
BR2_PACKAGE_DHRYSTONE=y
BR2_PACKAGE_LMBENCH=y
BR2_PACKAGE_NBENCH=y
BR2_PACKAGE_STRACE=y
BR2_PACKAGE_WHETSTONE=y
BR2_PACKAGE_MTD=y
BR2_PACKAGE_USBUTILS=y
BR2_PACKAGE_LIBGCRYPT=y
BR2_PACKAGE_SQLITE=y
BR2_PACKAGE_JPEG=y
BR2_PACKAGE_LIBPNG=y
BR2_PACKAGE_READLINE=y
BR2_PACKAGE_EVENT_TEST=y
BR2_PACKAGE_RTSCTS_UTIL=y
BR2_PACKAGE_INETUTILS=y
BR2_PACKAGE_IPERF=y
BR2_TARGET_ROOTFS_EXT2=y
BR2_TARGET_ROOTFS_UBIFS=y
# BR2_TARGET_ROOTFS_TAR is not set
BR2_TARGET_ROOTFS_INITRAMFS=y
BR2_LINUX_KERNEL=y
BR2_LINUX_KERNEL_CUSTOM_TREE=y
BR2_LINUX_KERNEL_CUSTOM_PATH="linux/linux-kernel"
BR2_LINUX_KERNEL_PATCH="linux/patch"
BR2_LINUX_KERNEL_DEFCONFIG="BF609-EZKIT"
```

## configs/chip_defconfig
```kconfig
BR2_arm=y
BR2_cortex_a8=y
BR2_ARM_EABIHF=y
BR2_BACKUP_SITE="http://sources.buildroot.net/"
BR2_KERNEL_MIRROR="http://www.kernel.org/pub/"
BR2_LUAROCKS_MIRROR="http://luarocks.org/repositories/rocks"
BR2_CPAN_MIRROR="http://search.cpan.org/CPAN"
BR2_PACKAGE_OVERRIDE_FILE="$(TOPDIR)/local.mk"
BR2_TOOLCHAIN_EXTERNAL=y
BR2_ENABLE_LOCALE_PURGE=y
BR2_ENABLE_LOCALE_WHITELIST="C en_US"
BR2_TARGET_OPTIMIZATION="-pipe"
BR2_TARGET_GENERIC_HOSTNAME="chip"
BR2_TARGET_GENERIC_ROOT_PASSWD="chip"
BR2_TARGET_GENERIC_GETTY_BAUDRATE_115200=y
BR2_ROOTFS_USERS_TABLES="board/nextthing/chip/users_table.txt"
BR2_ROOTFS_OVERLAY="board/nextthing/chip/overlay"
BR2_ROOTFS_POST_BUILD_SCRIPT="board/nextthing/chip/post-build.sh"
BR2_LINUX_KERNEL=y
BR2_LINUX_KERNEL_CUSTOM_GIT=y
BR2_LINUX_KERNEL_CUSTOM_REPO_URL="https://github.com/NextThingCo/CHIP-linux.git"
BR2_LINUX_KERNEL_CUSTOM_REPO_VERSION="836bc7d62b00557f86e1d"
BR2_LINUX_KERNEL_PATCH="wext_priv.patch"
BR2_LINUX_KERNEL_USE_CUSTOM_CONFIG=y
BR2_LINUX_KERNEL_CUSTOM_CONFIG_FILE="board/nextthing/chip/linux.config"
BR2_LINUX_KERNEL_ZIMAGE=y
BR2_LINUX_KERNEL_DTS_SUPPORT=y
BR2_LINUX_KERNEL_INTREE_DTS_NAME="sun5i-r8-chip"
BR2_LINUX_KERNEL_INSTALL_TARGET=y
BR2_PACKAGE_BUSYBOX_SHOW_OTHERS=y
BR2_PACKAGE_HWTEST=y
BR2_PACKAGE_ALSA_UTILS=y
BR2_PACKAGE_ALSA_UTILS_APLAY=y
BR2_PACKAGE_MPG123=y
BR2_PACKAGE_SOX=y
BR2_PACKAGE_MMC_UTILS=y
BR2_PACKAGE_MTD=y
BR2_PACKAGE_MTD_MKFSUBIFS=y
BR2_PACKAGE_LSUIO=y
BR2_PACKAGE_PCIUTILS=y
BR2_PACKAGE_AVAHI=y
BR2_PACKAGE_AVAHI_DAEMON=y
BR2_PACKAGE_AVAHI_LIBDNSSD_COMPATIBILITY=y
BR2_PACKAGE_BLUEZ_UTILS_COMPAT=y
BR2_PACKAGE_BLUEZ_UTILS_AUDIO=y
BR2_PACKAGE_BLUEZ_UTILS_USB=y
BR2_PACKAGE_BLUEZ_UTILS_GATT=y
BR2_PACKAGE_CONNMAN=y
BR2_PACKAGE_CONNMAN_WIFI=y
BR2_PACKAGE_CONNMAN_WISPR=y
BR2_PACKAGE_CONNMAN_BLUETOOTH=y
BR2_PACKAGE_CONNMAN_CLIENT=y
BR2_PACKAGE_IPERF3=y
BR2_PACKAGE_IPROUTE2=y
BR2_PACKAGE_OPENOBEX=y
BR2_PACKAGE_OPENOBEX_BLUEZ=y
BR2_PACKAGE_OPENOBEX_LIBUSB=y
BR2_PACKAGE_OPENOBEX_APPS=y
BR2_PACKAGE_OPENOBEX_SYSLOG=y
BR2_PACKAGE_OPENOBEX_DUMP=y
BR2_PACKAGE_OPENSSH=y
BR2_PACKAGE_RTL8723BS_BT=y
BR2_PACKAGE_RTL8723BS_BT_CUSTOM_GIT=y
BR2_PACKAGE_RTL8723BS_BT_CUSTOM_REPO_URL="https://github.com/lwfinger/rtl8723bs_bt.git"
BR2_PACKAGE_RTL8723BS_BT_CUSTOM_REPO_VERSION="master"
BR2_PACKAGE_RTL8723BS_MP_DRIVER=y
BR2_PACKAGE_RTL8723BS_MP_DRIVER_CUSTOM_GIT=y
BR2_PACKAGE_RTL8723BS_MP_DRIVER_CUSTOM_REPO_URL="https://github.com/NextThingCo/RTL8723BS.git"
BR2_PACKAGE_RTL8723BS_MP_DRIVER_CUSTOM_REPO_VERSION="master"
BR2_PACKAGE_TCPDUMP=y
BR2_PACKAGE_WGET=y
BR2_PACKAGE_WPA_SUPPLICANT_AP_SUPPORT=y
BR2_PACKAGE_WPA_SUPPLICANT_EAP=y
BR2_PACKAGE_WPA_SUPPLICANT_HOTSPOT=y
BR2_PACKAGE_WPA_SUPPLICANT_DEBUG_SYSLOG=y
BR2_PACKAGE_WPA_SUPPLICANT_CLI=y
BR2_PACKAGE_WPA_SUPPLICANT_DBUS_INTROSPECTION=y
BR2_PACKAGE_SUDO=y
BR2_PACKAGE_KMOD=y
BR2_PACKAGE_KMOD_TOOLS=y
BR2_TARGET_ROOTFS_CPIO=y
BR2_TARGET_ROOTFS_UBIFS=y
BR2_TARGET_ROOTFS_UBIFS_LEBSIZE=0x1f8000
BR2_TARGET_ROOTFS_UBIFS_MINIOSIZE=0x4000
BR2_TARGET_ROOTFS_UBIFS_MAXLEBCNT=2000
BR2_TARGET_ROOTFS_UBIFS_LZO=y
BR2_TARGET_ROOTFS_UBI=y
BR2_TARGET_ROOTFS_UBI_PEBSIZE=0x200000
BR2_TARGET_ROOTFS_UBI_SUBSIZE=16384
BR2_TARGET_UBOOT=y
BR2_TARGET_UBOOT_BOARDNAME="CHIP"
BR2_TARGET_UBOOT_CUSTOM_GIT=y
BR2_TARGET_UBOOT_CUSTOM_REPO_URL="https://github.com/NextThingCo/CHIP-u-boot.git"
BR2_TARGET_UBOOT_CUSTOM_REPO_VERSION="dbbada8"
BR2_TARGET_UBOOT_FORMAT_CUSTOM=y
BR2_TARGET_UBOOT_FORMAT_CUSTOM_NAME="u-boot-dtb.bin"
BR2_TARGET_UBOOT_SPL=y
BR2_TARGET_UBOOT_SPL_NAME="spl/sunxi-spl.bin"
BR2_TARGET_UBOOT_ENVIMAGE=y
BR2_TARGET_UBOOT_ENVIMAGE_SOURCE="board/nextthing/chip/uboot-env"
BR2_TARGET_UBOOT_ENVIMAGE_SIZE="0x400000"
BR2_PACKAGE_HOST_SUNXI_TOOLS=y
```

## configs/getinge_netcom_defconfig
```kconfig
BR2_arm=y
BR2_arm926t=y
BR2_JLEVEL=4
BR2_TOOLCHAIN_EXTERNAL=y
BR2_TARGET_GENERIC_HOSTNAME="netcom"
BR2_TARGET_GENERIC_ISSUE="Welcome to Getinge NetCOM"
BR2_ROOTFS_DEVICE_CREATION_DYNAMIC_DEVTMPFS=y
BR2_TARGET_GENERIC_GETTY_PORT="ttyS4"
BR2_ROOTFS_POST_BUILD_SCRIPT="board/getinge/netcom/post-build.sh"
BR2_ROOTFS_POST_IMAGE_SCRIPT="board/getinge/netcom/post-image.sh"
BR2_PACKAGE_BUSYBOX_CONFIG="board/getinge/netcom/busybox-1.18.4.config"
# BR2_PACKAGE_MTD_FLASHCP is not set
# BR2_PACKAGE_MTD_FLASH_ERASEALL is not set
# BR2_PACKAGE_MTD_FLASH_INFO is not set
# BR2_PACKAGE_MTD_FLASH_LOCK is not set
# BR2_PACKAGE_MTD_FLASH_UNLOCK is not set
# BR2_PACKAGE_MTD_MTD_DEBUG is not set
# BR2_PACKAGE_MTD_NANDDUMP is not set
# BR2_PACKAGE_MTD_NANDTEST is not set
# BR2_PACKAGE_MTD_UBIATTACH is not set
# BR2_PACKAGE_MTD_UBICRC32 is not set
# BR2_PACKAGE_MTD_UBIDETACH is not set
# BR2_PACKAGE_MTD_UBIFORMAT is not set
# BR2_PACKAGE_MTD_UBIMKVOL is not set
# BR2_PACKAGE_MTD_UBINFO is not set
# BR2_PACKAGE_MTD_UBINIZE is not set
# BR2_PACKAGE_MTD_UBIRENAME is not set
# BR2_PACKAGE_MTD_UBIRMVOL is not set
# BR2_PACKAGE_MTD_UBIRSVOL is not set
# BR2_PACKAGE_MTD_UBIUPDATEVOL is not set
BR2_PACKAGE_UBOOT_TOOLS=y
BR2_PACKAGE_HASERL=y
BR2_PACKAGE_OPENSSL=y
BR2_PACKAGE_LIBCURL=y
BR2_PACKAGE_CURL=y
BR2_PACKAGE_EXPAT=y
BR2_PACKAGE_CIFS_UTILS=y
BR2_PACKAGE_DROPBEAR=y
BR2_PACKAGE_ETHTOOL=y
BR2_PACKAGE_HEIRLOOM_MAILX=y
BR2_PACKAGE_TCPDUMP=y
BR2_PACKAGE_GPBR_TOOL=y
BR2_PACKAGE_IPSETD=y
BR2_PACKAGE_RESPAWND=y
BR2_PACKAGE_NETCOM_WEB=y
BR2_PACKAGE_ETC_CONFD=y
BR2_PACKAGE_NETCOM_CGIC=y
BR2_PACKAGE_NETCOM_APPS=y
BR2_PACKAGE_NETCOM_APPS_AGS=y
BR2_PACKAGE_NETCOM_APPS_DATABUFFERD=y
BR2_PACKAGE_NETCOM_APPS_DEVCOMD=y
BR2_PACKAGE_NETCOM_APPS_MODBUSD=y
BR2_PACKAGE_NETCOM_APPS_NCLIC=y
BR2_PACKAGE_NETCOM_APPS_NCUTILD=y
BR2_PACKAGE_NETCOM_APPS_NETCOMLOCATOR=y
BR2_PACKAGE_NETCOM_APPS_PACS2000D=y
BR2_PACKAGE_NETCOM_APPS_PACSBUFFERD=y
BR2_PACKAGE_NETCOM_APPS_PRINTLOGD=y
BR2_PACKAGE_NETCOM_APPS_PRINTSCAND=y
BR2_PACKAGE_NETCOM_APPS_PRTUTIL=y
BR2_PACKAGE_NETCOM_APPS_REMOTEAGENT=y
BR2_PACKAGE_NETCOM_APPS_SERSRVD=y
BR2_PACKAGE_NETCOM_APPS_SNTPDATE=y
BR2_PACKAGE_NETCOM_APPS_WEBSETUP=y
BR2_PACKAGE_LIBAGENTEMBEDDED=y
BR2_PACKAGE_NETCOM_USBRUN=y
BR2_PACKAGE_NETCOM_COMMON=y
BR2_PACKAGE_NETCOM_LOGUSB=y
BR2_PACKAGE_NETCOM_LICENSE=y
BR2_PACKAGE_NETCOM_REGISTER=y
BR2_PACKAGE_UBOOT_TEST_SCRIPT=y
BR2_TARGET_ROOTFS_JFFS2=y
BR2_TARGET_ROOTFS_JFFS2_NOCLEANMARKER=y
BR2_TARGET_ROOTFS_JFFS2_PAD=y
BR2_TARGET_ROOTFS_JFFS2_SUMMARY=y
BR2_TARGET_UBOOT=y
BR2_TARGET_UBOOT_BOARDNAME="getinge_netcomv3"
BR2_TARGET_UBOOT_2011_12=y
BR2_TARGET_UBOOT_CUSTOM_PATCH_DIR="board/getinge/netcom/u-boot-2011.12-patches/"
# BR2_TARGET_UBOOT_NETWORK is not set
BR2_TARGET_UBOOT_ENVIMAGE=y
BR2_TARGET_UBOOT_ENVIMAGE_FILE="board/getinge/netcom/u-boot-env.txt"
BR2_TARGET_UBOOT_ENVIMAGE_SIZE="0x2100"
BR2_TARGET_AT91BOOTSTRAP=y
BR2_TARGET_AT91BOOTSTRAP_BOARD="at91sam9m10g45ek"
BR2_TARGET_AT91BOOTSTRAP_CUSTOM_PATCH_DIR="board/getinge/netcom/at91bootstrap-1.16-patches/"
BR2_LINUX_KERNEL=y
BR2_LINUX_KERNEL_CUSTOM_VERSION=y
BR2_LINUX_KERNEL_CUSTOM_VERSION_VALUE="3.3"
BR2_LINUX_KERNEL_PATCH="board/getinge/netcom/linux-3.3-patches/"
BR2_LINUX_KERNEL_USE_CUSTOM_CONFIG=y
BR2_LINUX_KERNEL_CUSTOM_CONFIG_FILE="board/getinge/netcom/linux-3.3.config"
```
