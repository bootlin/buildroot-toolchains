## configs/imx6_seco_uq7_debug_defconfig
```kconfig
BR2_arm=y
BR2_cortex_a9=y
BR2_ARM_EABIHF=y
BR2_ARM_ENABLE_NEON=y
BR2_ARM_FPU_NEON=y
BR2_ENABLE_DEBUG=y
BR2_STRIP_none=y
BR2_OPTIMIZE_2=y
BR2_TOOLCHAIN_EXTERNAL=y
BR2_TOOLCHAIN_EXTERNAL_GDB_SERVER_COPY=y
BR2_TARGET_GENERIC_GETTY_PORT="ttymxc1"
BR2_LINUX_KERNEL=y
BR2_LINUX_KERNEL_CUSTOM_GIT=y
BR2_LINUX_KERNEL_CUSTOM_REPO_URL="git@tau.free-electrons.com:eca/linux.git"
BR2_LINUX_KERNEL_CUSTOM_REPO_VERSION="e357b60fe7c185acbdcd9614eb2885ace1072e75"
BR2_LINUX_KERNEL_DEFCONFIG="imx6_seco_uq7"
BR2_LINUX_KERNEL_ZIMAGE=y
BR2_LINUX_KERNEL_DTS_SUPPORT=y
BR2_LINUX_KERNEL_INTREE_DTS_NAME="imx6q-secocq7-pitx-xboard-uq7"
BR2_LINUX_KERNEL_INSTALL_TARGET=y
BR2_PACKAGE_STRACE=y
BR2_PACKAGE_QT5CINEX=y
BR2_PACKAGE_QT5CINEX_HD=y
BR2_PACKAGE_QT5=y
BR2_PACKAGE_QT5BASE_LICENSE_APPROVED=y
BR2_PACKAGE_QT5BASE_EXAMPLES=y
BR2_PACKAGE_QT5BASE_SQLITE_QT=y
BR2_PACKAGE_QT5BASE_OPENGL_LIB=y
BR2_PACKAGE_QT5BASE_LINUXFB=y
BR2_PACKAGE_QT5BASE_DEFAULT_QPA="eglfs"
BR2_PACKAGE_QT5BASE_GIF=y
BR2_PACKAGE_QT5BASE_JPEG=y
BR2_PACKAGE_QT5BASE_ICU=y
BR2_PACKAGE_QT5CONNECTIVITY=y
BR2_PACKAGE_FREESCALE_IMX=y
BR2_PACKAGE_FREESCALE_IMX_PLATFORM_IMX6Q=y
BR2_PACKAGE_GPU_VIV_BIN_MX6Q=y
BR2_PACKAGE_GPU_VIV_BIN_MX6Q_EXAMPLES=y
BR2_PACKAGE_WF111=y
BR2_PACKAGE_SQLITE=y
BR2_PACKAGE_LIBJPEG=y
BR2_PACKAGE_LIBUSB=y
BR2_PACKAGE_DHCPCD=y
BR2_PACKAGE_IPERF=y
BR2_PACKAGE_OPENSSH=y
BR2_PACKAGE_WIRELESS_TOOLS=y
BR2_PACKAGE_WPA_SUPPLICANT=y
BR2_PACKAGE_WPA_SUPPLICANT_AP_SUPPORT=y
BR2_PACKAGE_WPA_SUPPLICANT_EAP=y
BR2_PACKAGE_WPA_SUPPLICANT_HOTSPOT=y
BR2_PACKAGE_WPA_SUPPLICANT_CLI=y
BR2_PACKAGE_WPA_SUPPLICANT_PASSPHRASE=y
BR2_TARGET_ROOTFS_EXT2=y
BR2_TARGET_ROOTFS_EXT2_4=y
BR2_TARGET_ROOTFS_TAR_BZIP2=y
BR2_TARGET_UBOOT=y
BR2_TARGET_UBOOT_BOARDNAME="secomx6quq7"
BR2_TARGET_UBOOT_CUSTOM_GIT=y
BR2_TARGET_UBOOT_CUSTOM_REPO_URL="git@tau.free-electrons.com:eca/uboot.git"
BR2_TARGET_UBOOT_CUSTOM_REPO_VERSION="b2ed66e72a2685a4eb457bba2005e640f3819a35"
BR2_TARGET_UBOOT_FORMAT_IMX=y
BR2_PACKAGE_HOST_ANDROID_TOOLS=y
BR2_PACKAGE_HOST_ANDROID_TOOLS_FASTBOOT=y
BR2_PACKAGE_HOST_IMX_USB_LOADER=y
```

## configs/imx6_seco_uq7_defconfig
```kconfig
BR2_arm=y
BR2_cortex_a9=y
BR2_ARM_EABIHF=y
BR2_GLOBAL_PATCH_DIR="board/freescale/imx6sabresd/patches"
BR2_TOOLCHAIN_EXTERNAL=y
BR2_ROOTFS_DEVICE_CREATION_DYNAMIC_EUDEV=y
BR2_TARGET_GENERIC_GETTY_PORT="ttymxc1"
BR2_LINUX_KERNEL=y
BR2_LINUX_KERNEL_CUSTOM_GIT=y
BR2_LINUX_KERNEL_CUSTOM_REPO_URL="git@tau.free-electrons.com:eca/linux.git"
BR2_LINUX_KERNEL_CUSTOM_REPO_VERSION="2b0f9eabe8e41142ea7468271d130cc4af6209e1"
BR2_LINUX_KERNEL_DEFCONFIG="imx6_seco_uq7"
BR2_LINUX_KERNEL_ZIMAGE=y
BR2_LINUX_KERNEL_DTS_SUPPORT=y
BR2_LINUX_KERNEL_INTREE_DTS_NAME="imx6q-secocq7-pitx-xboard-uq7"
BR2_PACKAGE_STRACE=y
BR2_PACKAGE_QT5CINEX=y
BR2_PACKAGE_QT5CINEX_HD=y
BR2_PACKAGE_QT5=y
BR2_PACKAGE_QT5BASE_LICENSE_APPROVED=y
BR2_PACKAGE_QT5BASE_EXAMPLES=y
BR2_PACKAGE_QT5BASE_SQLITE_QT=y
BR2_PACKAGE_QT5BASE_OPENGL_LIB=y
BR2_PACKAGE_QT5BASE_LINUXFB=y
BR2_PACKAGE_QT5BASE_DEFAULT_QPA="eglfs"
BR2_PACKAGE_QT5BASE_GIF=y
BR2_PACKAGE_QT5BASE_JPEG=y
BR2_PACKAGE_QT5BASE_ICU=y
BR2_PACKAGE_QT5CONNECTIVITY=y
BR2_PACKAGE_FREESCALE_IMX=y
BR2_PACKAGE_FREESCALE_IMX_PLATFORM_IMX6Q=y
BR2_PACKAGE_GPU_VIV_BIN_MX6Q=y
BR2_PACKAGE_GPU_VIV_BIN_MX6Q_EXAMPLES=y
BR2_PACKAGE_SQLITE=y
BR2_TARGET_ROOTFS_TAR_GZIP=y
BR2_TARGET_UBOOT=y
BR2_TARGET_UBOOT_BOARDNAME="mx6qsabresd"
BR2_TARGET_UBOOT_CUSTOM_GIT=y
BR2_TARGET_UBOOT_CUSTOM_REPO_URL="git://git.freescale.com/imx/uboot-imx.git"
BR2_TARGET_UBOOT_CUSTOM_REPO_VERSION="rel_imx_3.10.17_1.0.0_ga"
BR2_TARGET_UBOOT_FORMAT_IMX=y
BR2_PACKAGE_HOST_E2FSPROGS=y
BR2_PACKAGE_HOST_GENEXT2FS=y
```

## configs/pandaboard_defconfig
```kconfig
BR2_arm=y
BR2_cortex_a9=y
BR2_SOURCEFORGE_MIRROR="easynews"
BR2_TOOLCHAIN_EXTERNAL=y
BR2_TOOLCHAIN_EXTERNAL_CUSTOM=y
BR2_TOOLCHAIN_EXTERNAL_PATH=""
BR2_TOOLCHAIN_EXTERNAL_CUSTOM_PREFIX="arm-none-linux-gnueabi"
BR2_TOOLCHAIN_EXTERNAL_CUSTOM_GLIBC=y
BR2_TOOLCHAIN_EXTERNAL_CXX=y
BR2_PACKAGE_GDB_SERVER=y
BR2_TARGET_ANALOGDEVICES=y
BR2_TARGET_GENERIC_HOSTNAME="Pelican"
BR2_TARGET_GENERIC_ISSUE="Welcome to Buildroot for Pelican"
BR2_ROOTFS_DEVICE_TABLE="target/device/AnalogDevices/device_table-min.txt"
BR2_ROOTFS_SKELETON_CUSTOM=y
BR2_ROOTFS_SKELETON_CUSTOM_PATH=""
BR2_BUSYBOX_VERSION_1_17_X=y
BR2_PACKAGE_BUSYBOX_CONFIG=""
BR2_PACKAGE_CUSTOMIZE=y
BR2_PACKAGE_ALSA_UTILS=y
BR2_PACKAGE_ALSA_UTILS_AMIXER=y
BR2_PACKAGE_ALSA_UTILS_APLAY=y
BR2_PACKAGE_FLAC=y
BR2_PACKAGE_FFMPEG=y
BR2_PACKAGE_LIBID3TAG=y
BR2_PACKAGE_LIBMAD=y
BR2_PACKAGE_LIBOGG=y
BR2_PACKAGE_BONNIE=y
BR2_PACKAGE_STRACE=y
BR2_PACKAGE_QT=y
BR2_PACKAGE_QT_GIF=y
BR2_PACKAGE_QT_QTJPEG=y
BR2_PACKAGE_QT_QTPNG=y
BR2_PACKAGE_QT_QTTIFF=y
BR2_PACKAGE_QT_SQL_MODULE=y
BR2_PACKAGE_QT_MOUSE_PC=y
BR2_PACKAGE_QT_MOUSE_LINUXINPUT=y
BR2_PACKAGE_QT_MOUSE_TSLIB=y
BR2_PACKAGE_QT_KEYBOARD_LINUXINPUT=y
BR2_PACKAGE_DBUS=y
BR2_PACKAGE_LIRC=y
BR2_PACKAGE_USBUTILS=y
BR2_PACKAGE_LZO=y
BR2_PACKAGE_LIBGCRYPT=y
BR2_PACKAGE_OPENSSL=y
BR2_PACKAGE_OPENSSL_BIN=y
BR2_PACKAGE_SQLITE=y
BR2_PACKAGE_FONTCONFIG=y
BR2_PACKAGE_LIBPNG=y
BR2_PACKAGE_LIBUNGIF=y
BR2_PACKAGE_TIFF=y
BR2_PACKAGE_TSLIB=y
BR2_PACKAGE_LIBUSB_COMPAT=y
BR2_PACKAGE_LIBNEMESI=y
BR2_PACKAGE_LIBOSIP2=y
BR2_PACKAGE_NETEMBRYO=y
BR2_PACKAGE_LIBGLIB2=y
BR2_PACKAGE_LIBOIL=y
BR2_PACKAGE_READLINE=y
BR2_PACKAGE_LIBXML2=y
BR2_PACKAGE_BLUEZ_UTILS=y
BR2_PACKAGE_INETUTILS=y
BR2_PACKAGE_WIRELESS_TOOLS=y
BR2_TARGET_ROOTFS_EXT2=y
BR2_TARGET_ROOTFS_JFFS2=y
BR2_TARGET_ROOTFS_UBIFS=y
# BR2_TARGET_ROOTFS_TAR is not set
BR2_TARGET_ROOTFS_INITRAMFS=y
BR2_LINUX_KERNEL=y
BR2_LINUX_KERNEL_CUSTOM_TREE=y
BR2_LINUX_KERNEL_CUSTOM_PATH="linux/linux-2.6.x"
BR2_LINUX_KERNEL_PATCH="linux/patch"
BR2_LINUX_KERNEL_USE_CUSTOM_CONFIG=y
BR2_LINUX_KERNEL_CUSTOM_CONFIG_FILE="$(TOPDIR)/target/device/AnalogDevices/arch-arm/omap4_pandaboard_defconfig"
```

## configs/qmx6_qt5_demo_defconfig
```kconfig
# architecture
BR2_arm=y
BR2_cortex_a9=y
BR2_KERNEL_HEADERS_VERSION=y
BR2_DEFAULT_KERNEL_VERSION="3.10.17"
BR2_PACKAGE_HOST_LINUX_HEADERS_CUSTOM_3_10=y
BR2_TOOLCHAIN_BUILDROOT_EGLIBC=y
BR2_TOOLCHAIN_BUILDROOT_CXX=y

# system
BR2_TARGET_GENERIC_GETTY_PORT="ttymxc1"

# kernel
# Notice you need a recent version of u-boot (with DT support) to be able
# to boot this kernel
BR2_LINUX_KERNEL=y
BR2_LINUX_KERNEL_CUSTOM_GIT=y
BR2_LINUX_KERNEL_CUSTOM_REPO_URL="https://git.congatec.com/arm/qmx6_kernel.git"
# Last version of branch cgt_imx_3.10.17_1.0.0
BR2_LINUX_KERNEL_CUSTOM_REPO_VERSION="9bafbcba67f7bb2a48a5e05998cecb1165aa444f"
BR2_LINUX_KERNEL_DEFCONFIG="qmx6"
BR2_LINUX_KERNEL_UIMAGE_LOADADDR="0x10008000"
BR2_LINUX_KERNEL_DTS_SUPPORT=y
BR2_LINUX_KERNEL_INTREE_DTS_NAME="imx6q-qmx6"
BR2_LINUX_KERNEL_INSTALL_TARGET=y

# Graphics drivers
BR2_PACKAGE_FREESCALE_IMX=y
BR2_PACKAGE_FREESCALE_IMX_PLATFORM_IMX6Q=y
BR2_PACKAGE_GPU_VIV_BIN_MX6Q=y
BR2_PACKAGE_GPU_VIV_BIN_MX6Q_OUTPUT_FB=y

# Enable Qt5
BR2_PACKAGE_QT5=y
BR2_PACKAGE_QT5BASE_LICENSE_APPROVED=y
BR2_PACKAGE_QT5BASE_GUI=y
BR2_PACKAGE_QT5BASE_EGLFS=y
BR2_PACKAGE_QT5BASE_OPENGL_LIB=y
BR2_PACKAGE_QT5BASE_DEFAULT_QPA="eglfs"
BR2_PACKAGE_QT5BASE_PNG=y

# u-boot
# Change boardname depending of your product number
BR2_TARGET_UBOOT=y
BR2_TARGET_UBOOT_BOARDNAME="cgt_qmx6_pn016103"
BR2_TARGET_UBOOT_CUSTOM_GIT=y
BR2_TARGET_UBOOT_CUSTOM_REPO_URL="https://git.congatec.com/arm/qmx6_uboot.git"
BR2_TARGET_UBOOT_CUSTOM_REPO_VERSION="6388c474189b42c07bb865dd604c74483da099f3"
BR2_TARGET_UBOOT_FORMAT_CUSTOM=y
BR2_TARGET_UBOOT_FORMAT_CUSTOM_NAME="u-boot.pn016103.imx"

# Images
BR2_TARGET_ROOTFS_EXT2=y
BR2_TARGET_ROOTFS_EXT2_3=y

# Usefull host packages
BR2_PACKAGE_HOST_UBOOT_TOOLS=y
```

## nmi_wdt_test/Config.in
```kconfig
config BR2_PACKAGE_NMI_WDT_TEST
	bool "nmi wdt test"
	help
	  nmi wdt test suite
```

## os/Config.in
```kconfig
menu "Kernel"

source "os/linux/Config.in"

source "os/nuttx/Config.in"

endmenu
```

## os/nuttx/Config.in
```kconfig
config BR2_NUTTX_KERNEL
       bool "Nuttx Kernel"
       help 
         nuttx kernel

if BR2_NUTTX_KERNEL

config BR2_NUTTX_TARGET_BOARD
       string "Target board"
       default stm32f4discovery
       help
         Nuttx target board

config BR2_NUTTX_DEFCONFIG
       string "Nuttx defconfig"
       default pluto_defconfig


endif
```

## package/bfin-canned-demos/Config.in
```kconfig
menuconfig BR2_PACKAGE_BFIN_CANNED_DEMOS
	bool "bfin canned demos"
        select BR2_PACKAGE_THTTPD
	help
	  bfin canned demos

if BR2_PACKAGE_BFIN_CANNED_DEMOS

config BR2_PACKAGE_USER_NDSO
        bool "Networked Software Defined Storage Oscilloscope /dev/sport"
        select BR2_PACKAGE_LIB_LIBPNG
        select BR2_PACKAGE_GNUPLOT_OLD

config BR2_PACKAGE_USER_NDSO_IIO
        bool "Networked Software Defined Storage Oscilloscope IIO"
        select BR2_PACKAGE_LIB_LIBPNG
        select BR2_PACKAGE_GNUPLOT_OLD

config BR2_PACKAGE_USER_AWG
        bool "Networked Arbitrary Waveform Genertor"
        select BR2_PACKAGE_LIB_LIBPNG
        select BR2_PACKAGE_GNUPLOT_OLD

config BR2_PACKAGE_USER_PPIFPGACGI
        bool "Networked PPI/FPGA Demo Project"

config BR2_PACKAGE_PPIFCDCGI
        bool "CGI based Test Application for the PPI Frame Capture Driver"

endif
```

## package/bfin-gptimer/Config.in
```kconfig
config BR2_PACKAGE_BFIN_GPTIMER
	bool "bfin gptimer test"
	help
	  Bfin gptimer test suite
```

## package/bfin-linkport/Config.in
```kconfig
config BR2_PACKAGE_BFIN_LINKPORT
	bool "bfin linkport test"
	help
	  Bfin linkport test suite
```

## package/bluez_utils/Config.in
```kconfig
config BR2_PACKAGE_BLUEZ_UTILS
	bool "bluez_utils"
	depends on BR2_PACKAGE_DBUS
	help
	  bluez utils

	  http://www.kernel.org/pub/linux/bluetooth
```

## package/cgic/Config.in
```kconfig
config BR2_PACKAGE_CGIC
	bool "cgic"
	help
	  cgic is an ANSI C-language library for the creation of
	  CGI-based World Wide Web applications.
```

## package/corebld/Config.in
```kconfig
config BR2_PACKAGE_COREBLD
	bool "Core B support tools"
	help
	  Core B support tools
```
