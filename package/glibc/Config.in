## package/glibc/Config.in
```kconfig
if BR2_TOOLCHAIN_BUILDROOT_GLIBC

config BR2_PACKAGE_GLIBC
	bool
	default y
	select BR2_PACKAGE_LINUX_HEADERS
	# SSP not supported on microblaze
	select BR2_TOOLCHAIN_HAS_SSP if !BR2_microblaze

endif
```

## package/gnuplot-old/Config.in
```kconfig
config BR2_PACKAGE_GNUPLOT_OLD
	bool "gnuplot old version"
	help
	  A portable command-line driven graphing utility.

	  http://www.gnuplot.info/
```

## package/heirloom-mailx/Config.in
```kconfig
config BR2_PACKAGE_HEIRLOOM_MAILX
	bool "heirloom-mailx"
	help
	  Heirloom mailx (previously known as nail) is a mail user
	  agent for Unix systems.

	  http://heirloom.sourceforge.net/mailx.html
```

## package/hwtest/Config.in
```kconfig
config BR2_PACKAGE_HWTEST
        bool "hwtest"
	select BR2_PACKAGE_STRESS
	select BR2_PACKAGE_LSHW
	select BR2_PACKAGE_I2C_TOOLS
	select BR2_PACKAGE_IW
        help
          Small script to do some hardware tests on CHIP
```

## package/icc/Config.in
```kconfig
config BR2_PACKAGE_ICC
	bool "bfin inter-core communication support"
	depends on BR2_LINUX_KERNEL
	depends on BR2_PACKAGE_LIBMCAPI
	help
		bfin inter-core communication support
choice
        prompt "ICC cpu type"
        default BR2_PACKAGE_ICC_CPU_BF609
        depends on BR2_PACKAGE_ICC

config BR2_PACKAGE_ICC_CPU_BF609
        bool    "BF609"

config BR2_PACKAGE_ICC_CPU_BF561
        bool    "BF561"
endchoice
```

## package/imx-usb-loader/Config.in.host
```kconfig
config BR2_PACKAGE_HOST_IMX_USB_LOADER
	bool "host imx usb loader"
	depends on BR2_PACKAGE_LIBUSB
	depends on BR2_TOOLCHAIN_HAS_THREADS
	help
	  i.MX/Vybrid recovery utility

	  https://github.com/boundarydevices/imx_usb_loader
```

## package/inetutils/Config.in
```kconfig
config BR2_PACKAGE_INETUTILS
	bool "inetutils"
	help
	  inetutils

	  http://www.gnu.org/software/inetutils/
```

## package/libmcapi/Config.in
```kconfig
config BR2_PACKAGE_LIBMCAPI
	bool "libmcapi"
	depends on BR2_LINUX_KERNEL
	help
		libmcapi
```

## package/libnemesi/Config.in
```kconfig
config BR2_PACKAGE_LIBNEMESI
	bool "libnemesi"
	depends on BR2_PACKAGE_NETEMBRYO
	help
	  the RTSP/RTP client library

	  http://lscube.org/projects/libnemesi
```

## package/linphone/Config.in
```kconfig
config BR2_PACKAGE_LINPHONE
	bool "linphone"
	select BR2_PACKAGE_SPEEX
	select BR2_PACKAGE_LIBOSIP2
	select BR2_PACKAGE_LIBEXOSIP2
	select BR2_PACKAGE_READLINE
	select BR2_PACKAGE_NCURSES
	select BR2_PACKAGE_ALSA_LIB
	select BR2_PACKAGE_LIBBFGDOTS

	help
	  A network phone.

	  http://www.linphone.org/

config BF2_PACKAGE_LINPHONE_VIDEO
        bool "Enable video"
        depends on BR2_PACKAGE_LINPHONE && BR2_PACKAGE_LIBV4L
        select BR2_PACKAGE_SDL
        select BR2_PACKAGE_FFMPEG
```

## package/linuxptp/Config.in
```kconfig
config BR2_PACKAGE_LINUXPTP
	bool "linuxptp"
	help
	  Precision Time Protocol (PTP) as defined by the IEEE 1588 standard version 2
	  Linux implementation with Linux hardware timestamp API support.

	  http://sourceforge.net/projects/linuxptp
```

## package/lirc/Config.in
```kconfig
config BR2_PACKAGE_LIRC
	bool "lirc"
	help
	  LIRC is a package that allows you to decode and send infra-red signals of many (but not all) commonly used remote controls. 

	  http://www.lirc.org/
```

## package/malloc_perf_test/Config.in
```kconfig
config BR2_PACKAGE_MALLOC_PERF_TEST
	bool "malloc perf test"
	help
	  malloc perf test suite
```

## package/microsemi-spi-fpga/Config.in
```kconfig
config BR2_PACKAGE_MICROSEMI_SPI_FPGA
	bool "microsemi FPGA SPI programmer"
	help
	  Microsemi FPGA programing tool.
```

## package/multimedia/libbfgdots/Config.in
```kconfig
config BR2_PACKAGE_LIBBFGDOTS
	bool "libbfgdots"
	help
	  blackfin g.729 codec library
```

## package/multimedia/play/Config.in
```kconfig
config BR2_PACKAGE_PLAY
        bool "play"
        help
          Play application can play .wav files; tone can generate various sounds.
```

## package/musl/Config.in
```kconfig
config BR2_PACKAGE_MUSL
	bool
	default y
	depends on BR2_TOOLCHAIN_USES_MUSL
	select BR2_PACKAGE_LINUX_HEADERS
	# SSP broken on i386/ppc: http://www.openwall.com/lists/musl/2016/12/04/2
	# SSP not supported on microblaze
	select BR2_TOOLCHAIN_HAS_SSP if !(BR2_i386 || BR2_microblaze || BR2_powerpc)
	# Compatibility headers: cdefs.h, queue.h
	select BR2_PACKAGE_MUSL_COMPAT_HEADERS
```

## package/nbench/Config.in
```kconfig
config BR2_PACKAGE_NBENCH
	bool "nbench"
	help
	  nbench is a Linux/Unix port of release 2 of BYTE Magazine's BYTEmark
	  benchmark program (previously known as BYTE's Native Mode
	  Benchmarks). These are Native Mode (a.k.a. Algorithm Level) tests;
	  benchmarks designed to expose the capabilities of a system's CPU,
	  FPU, and memory system

	  http://www.tux.org/~mayer/linux/bmark.html
```

## package/netembryo/Config.in
```kconfig
config BR2_PACKAGE_NETEMBRYO
	bool "netembryo"
	help
	  the network abstraction library Feng and Libnemesi depend upon

	  http://lscube.org/projects/netembryo
```

## package/netperf/Config.in.host
```kconfig
config BR2_PACKAGE_HOST_NETPERF
	bool "host netperf"
	help
	  Network performance benchmark tool

	  http://www.netperf.org/
```

## package/newlib/Config.in
```kconfig
config BR2_PACKAGE_NEWLIB
       bool
       depends on BR2_TOOLCHAIN_USES_NEWLIB
       default y
```

## package/pcmciautils/Config.in
```kconfig
config BR2_PACKAGE_PCMCIAUTILS
	bool "pcmciautils"
	depends on BR2_PACKAGE_LIBSYSFS
	help
	  pcmciautils
```

## package/popt/Config.in
```kconfig
config BR2_PACKAGE_POPT
	bool "popt"
	select BR2_PACKAGE_LIBICONV
	help
	  Popt is a C library for parsing command line parameters.

	  http://rpm5.org
```
