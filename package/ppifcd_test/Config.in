## package/pthread_test/Config.in
```kconfig
config BR2_PACKAGE_PTHREAD_TEST
	bool "pthread test"
	help
	  pthread test suite
```

## package/ptpd/Config.in
```kconfig
config BR2_PACKAGE_PTPD
	bool "ptpd v1"
	help
	  Precision Time Protocol (PTP) as defined by the IEEE 1588 standard version 1
	  plus support for Linux hardware timestamp API.

	  git://github.com/pohly/ptpd.git
	  http://sourceforge.net/projects/ptpd
```

## package/ptpd2/Config.in
```kconfig
config BR2_PACKAGE_PTPD2
	bool "ptpd v2"
	help
	  Precision Time Protocol (PTP) as defined by the IEEE 1588 standard version 2
	  plus support for Linux hardware timestamp API.

	  https://github.com/richardcochran/ptpd-phc
```

## package/rtl8723bs/Config.in
```kconfig
config BR2_PACKAGE_RTL8723BS
	bool "rtl8723bs"
	depends on BR2_LINUX_KERNEL
	help
	  Linux kernel module for the rtl8723bs SDIO WiFi module.

	  Make sure your target kernel has the following config
	  options enabled:

	    * CONFIG_MODULES: loadable module support
	    * CONFIG_CFG80211: cfg80211 wireless interface support

comment "rtl8723bs needs a Linux kernel to be built"
	depends on !BR2_LINUX_KERNEL

comment "rtl8723bs conflicts with rtl8723bs_mp_driver"
	depends on BR2_PACKAGE_RTL8723BS_MP_DRIVER

if BR2_PACKAGE_RTL8723BS
choice
	prompt "RTL8723BS Version"
	help
	  Select the specific RTL8723BS version you want to use

config BR2_PACKAGE_RTL8723BS_LATEST_VERSION
	bool "2015.04"

config BR2_PACKAGE_RTL8723BS_CUSTOM_VERSION
	bool "Custom version"
	help
	  This option allows to use a specific official versions

config BR2_PACKAGE_RTL8723BS_CUSTOM_GIT
	bool "Custom Git repository"

endchoice

config BR2_PACKAGE_RTL8723BS_CUSTOM_VERSION_VALUE
	string "RTL8723BS version"
	depends on BR2_PACKAGE_RTL8723BS_CUSTOM_VERSION

if BR2_PACKAGE_RTL8723BS_CUSTOM_GIT

config BR2_PACKAGE_RTL8723BS_CUSTOM_REPO_URL
	string "URL of custom repository"
	default BR2_PACKAGE_RTL8723BS_CUSTOM_GIT_REPO_URL \
		if BR2_PACKAGE_RTL8723BS_CUSTOM_GIT_REPO_URL != ""  # legacy

config BR2_PACKAGE_RTL8723BS_CUSTOM_REPO_VERSION
	string "Custom repository version"
	default BR2_PACKAGE_RTL8723BS_CUSTOM_GIT_VERSION \
		if BR2_PACKAGE_RTL8723BS_CUSTOM_GIT_VERSION != ""  # legacy
	help
	  Revision to use in the typical format used by Git
	  E.G. a sha id, a tag, branch, ..

endif
endif

config BR2_PACKAGE_RTL8723BS_VERSION
	string
	default "2015.04"	if BR2_PACKAGE_RTL8723BS_LATEST_VERSION
	default BR2_PACKAGE_RTL8723BS_CUSTOM_VERSION_VALUE \
		if BR2_PACKAGE_RTL8723BS_CUSTOM_VERSION
	default BR2_PACKAGE_RTL8723BS_CUSTOM_REPO_VERSION \
		if BR2_PACKAGE_RTL8723BS_CUSTOM_GIT
```

## package/rtl8723bs_bt/Config.in
```kconfig
config BR2_PACKAGE_RTL8723BS_BT
	bool "rtl8723bs_bt"
	depends on BR2_LINUX_KERNEL
	help
	  Firmware and config for the rtl8723bs_bt SDIO Bluetooth module.

	  Make sure your target kernel has the following config
	  options enabled:

	    * CONFIG_BT: bluetooth support
		* CONFIG_BT_HCIUART: bluetooth HCI UART serial driver

comment "rtl8723bs_bt needs a Linux kernel to be built"
	depends on !BR2_LINUX_KERNEL

if BR2_PACKAGE_RTL8723BS_BT
choice
	prompt "RTL8723BS_BT Version"
	help
	  Select the specific RTL8723BS_BT version you want to use

config BR2_PACKAGE_RTL8723BS_BT_LATEST_VERSION
	bool "2015.04"

config BR2_PACKAGE_RTL8723BS_BT_CUSTOM_VERSION
	bool "Custom version"
	help
	  This option allows to use a specific official versions

config BR2_PACKAGE_RTL8723BS_BT_CUSTOM_GIT
	bool "Custom Git repository"

endchoice

config BR2_PACKAGE_RTL8723BS_BT_CUSTOM_VERSION_VALUE
	string "RTL8723BS_BT version"
	depends on BR2_PACKAGE_RTL8723BS_BT_CUSTOM_VERSION

if BR2_PACKAGE_RTL8723BS_BT_CUSTOM_GIT

config BR2_PACKAGE_RTL8723BS_BT_CUSTOM_REPO_URL
	string "URL of custom repository"
	default BR2_PACKAGE_RTL8723BS_BT_CUSTOM_GIT_REPO_URL \
		if BR2_PACKAGE_RTL8723BS_BT_CUSTOM_GIT_REPO_URL != ""  # legacy

config BR2_PACKAGE_RTL8723BS_BT_CUSTOM_REPO_VERSION
	string "Custom repository version"
	default BR2_PACKAGE_RTL8723BS_BT_CUSTOM_GIT_VERSION \
		if BR2_PACKAGE_RTL8723BS_BT_CUSTOM_GIT_VERSION != ""  # legacy
	help
	  Revision to use in the typical format used by Git
	  E.G. a sha id, a tag, branch, ..

endif
endif

config BR2_PACKAGE_RTL8723BS_BT_VERSION
	string
	default "2015.04"	if BR2_PACKAGE_RTL8723BS_BT_LATEST_VERSION
	default BR2_PACKAGE_RTL8723BS_BT_CUSTOM_VERSION_VALUE \
		if BR2_PACKAGE_RTL8723BS_BT_CUSTOM_VERSION
	default BR2_PACKAGE_RTL8723BS_BT_CUSTOM_REPO_VERSION \
		if BR2_PACKAGE_RTL8723BS_BT_CUSTOM_GIT
```

## package/rtl8723bs_mp_driver/Config.in
```kconfig
config BR2_PACKAGE_RTL8723BS_MP_DRIVER
	bool "rtl8723bs_mp_driver"
	depends on BR2_LINUX_KERNEL
	select BR2_PACKAGE_WIRELESS_TOOLS
	help
	  Linux kernel module for the MP Test with rtl8723bs SDIO WiFi module.

	  Make sure your target kernel has the following config
	  options enabled:

	    * CONFIG_MODULES: loadable module support
	    * CONFIG_CFG80211: cfg80211 wireless interface support

comment "rtl8723bs MP driver needs a Linux kernel to be built"
	depends on !BR2_LINUX_KERNEL

comment "rtl8723bs_mp_driver conflicts with rtl8723bs"
	depends on BR2_PACKAGE_RTL8723BS

if BR2_PACKAGE_RTL8723BS_MP_DRIVER
choice
	prompt "RTL8723BS MP Driver Version"
	help
	  Select the specific RTL8723BS MP Driver version you want to use

config BR2_PACKAGE_RTL8723BS_MP_DRIVER_LATEST_VERSION
	bool "v4.3.16_13854.20150410_BTCOEX20150119-5844"

config BR2_PACKAGE_RTL8723BS_MP_DRIVER_CUSTOM_VERSION
	bool "Custom version"
	help
	  This option allows to use a specific official versions

config BR2_PACKAGE_RTL8723BS_MP_DRIVER_CUSTOM_GIT
	bool "Custom Git repository"

endchoice

config BR2_PACKAGE_RTL8723BS_MP_DRIVER_CUSTOM_VERSION_VALUE
	string "RTL8723BS MP Driver version"
	depends on BR2_PACKAGE_RTL8723BS_MP_DRIVER_CUSTOM_VERSION

if BR2_PACKAGE_RTL8723BS_MP_DRIVER_CUSTOM_GIT

config BR2_PACKAGE_RTL8723BS_MP_DRIVER_CUSTOM_REPO_URL
	string "URL of custom repository"
	default BR2_PACKAGE_RTL8723BS_MP_DRIVER_CUSTOM_GIT_REPO_URL \
		if BR2_PACKAGE_RTL8723BS_MP_DRIVER_CUSTOM_GIT_REPO_URL != ""  # legacy

config BR2_PACKAGE_RTL8723BS_MP_DRIVER_CUSTOM_REPO_VERSION
	string "Custom repository version"
	default BR2_PACKAGE_RTL8723BS_MP_DRIVER_CUSTOM_GIT_VERSION \
		if BR2_PACKAGE_RTL8723BS_MP_DRIVER_CUSTOM_GIT_VERSION != ""  # legacy
	help
	  Revision to use in the typical format used by Git
	  E.G. a sha id, a tag, branch, ..

endif
endif

config BR2_PACKAGE_RTL8723BS_MP_DRIVER_VERSION
	string
	default "v4.3.16_13854.20150410_BTCOEX20150119-5844" \
		if BR2_PACKAGE_RTL8723BS_MP_DRIVER_LATEST_VERSION
	default BR2_PACKAGE_RTL8723BS_MP_DRIVER_CUSTOM_VERSION_VALUE \
		if BR2_PACKAGE_RTL8723BS_MP_DRIVER_CUSTOM_VERSION
	default BR2_PACKAGE_RTL8723BS_MP_DRIVER_CUSTOM_REPO_VERSION \
		if BR2_PACKAGE_RTL8723BS_MP_DRIVER_CUSTOM_GIT
```

## package/rtscts_util/Config.in
```kconfig
config BR2_PACKAGE_RTSCTS_UTIL
	bool "UART flow control test utility"
	help
	  UART flow control test utility
```

## package/sport_test/Config.in
```kconfig
config BR2_PACKAGE_SPORT_TEST
	bool "bfin common sport test"
	help
	  Bfin common sport test suite
```

## package/sram_alloc_test/Config.in
```kconfig
config BR2_PACKAGE_SRAM_ALLOC_TEST
	bool "sram alloc test"
	help
	  sram alloc test suite
```

## package/thttpd-old/Config.in
```kconfig
config BR2_PACKAGE_THTTPD_OLD
	bool "thttpd old"
	help
	  thttpd is a simple, small, portable, fast, and secure HTTP server

	  http://www.acme.com/software/thttpd/
```

## package/twi_keypad_test/Config.in
```kconfig
config BR2_PACKAGE_TWI_KEYPAD_TEST
	bool "twi keypad test"
	help
	  twi keypad test suite
```

## package/twi_lcd_test/Config.in
```kconfig
config BR2_PACKAGE_TWI_LCD_TEST
	bool "twi lcd test"
	help
	  twi lcd test suite
```

## package/uclibcpp/Config.in
```kconfig
config BR2_PACKAGE_UCLIBCPP
       bool "uClibc++ C++ library"
       depends on BR2_TOOLCHAIN_BUILDROOT_NEWLIB
       help
	Uclibc++ library support. Smaller than libvstdc++
```

## package/v4l2_video_test/Config.in
```kconfig
config BR2_PACKAGE_V4L2_VIDEO_TEST
	bool "V4L2 video test program"
	help
	  Application for V4L2 video test
```

## package/version/Config.in
```kconfig
config BR2_PACKAGE_VERSION
	bool "version command"
	help
	  version command display kernel toolchain user version
```

## package/video_test/Config.in
```kconfig
config BR2_PACKAGE_VIDEO_TEST
	bool "video test program"
        help
          Application for frame buffer video test
```

## package/wf111/Config.in
```kconfig
config BR2_PACKAGE_WF111
	bool "wf111"
	depends on BR2_LINUX_KERNEL
	depends on BR2_ARM_CPU_ARMV5 || BR2_ARM_CPU_ARMV7A || BR2_i386
	# Binary tools are distributed alongside the driver, and are
	# dynamically compiled against the glibc
	depends on BR2_TOOLCHAIN_USES_GLIBC
	help
	  BlueGiga WF111 WiFi driver and utilities.

	  Warning: CONFIG_WIRELESS_EXT and CONFIG_WEXT_PRIV must be
	  selected in the Linux kernel configuration.

if BR2_PACKAGE_WF111

config BR2_PACKAGE_WF111_TARBALL_PATH
	string "WF111 tarball directory location"
	help
	  The WF111 tarball can be retrieve on the BlueGiga website after
	  registration. This options specify the path were the tarball is
	  locally saved.

	  http://www.bluegiga.com/en-US/products/wifi-modules/wf111-wifi-module/

endif
```

## package/xenomai/Config.in
```kconfig
config BR2_PACKAGE_XENOMAI
	bool "xenomai"
	help
	  A realtime solution for Linux 

	  http://www.xenomai.org/
```
