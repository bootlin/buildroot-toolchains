## package/dtc-overlay/Config.in.host
```kconfig
config BR2_PACKAGE_HOST_DTC_OVERLAY
	bool "host device tree compiler with overlay support"
	help
	  The Device Tree Compiler, dtc, takes as input a device-tree in
	  a give format and outputs a device-tree in another format.

	  This version is patched to support device tree overlays.

	  https://github.com/atenart/dtc
```

## package/edn/Config.in
```kconfig
config BR2_PACKAGE_EDN
	bool "EDN's DSP benchmark"
	help
	  EDN investigated the quality of code that DSP compilers produce.
```

## package/erestart_test/Config.in
```kconfig
config BR2_PACKAGE_ERESTART_TEST
	bool "erestart test"
	help
	  erestart test suite
```

## package/event_test/Config.in
```kconfig
config BR2_PACKAGE_EVENT_TEST
	bool "event test"
	help
	  Input event test suite
```

## package/file_operation_test/Config.in
```kconfig
config BR2_PACKAGE_FILE_OPERATION_TEST
	bool "file operation test"
	help
	  file operation test suite
```

## package/fixed_code_test/Config.in
```kconfig
config BR2_PACKAGE_FIXED_CODE_TEST
	bool "fixed code test"
	help
	  fixed code test suite
```

## package/freetype2/Config.in
```kconfig
config BR2_PACKAGE_FREETYPE2
	bool "freetype2"
	help
	  a small, efficient, highly customizeable software font engine.

	  http://www.freetype.org/freetype2
```

## package/genromfs/Config.in.host
```kconfig
config BR2_PACKAGE_HOST_GENROMFS
	bool "host genromfs"
	help
	  Tool to generate a ROMFS filesystem.

	  http://romfs.sourceforge.net/
```

## package/getinge/etc-confd/Config.in
```kconfig
config BR2_PACKAGE_ETC_CONFD
        bool "conf.d default image"
	help
	  This is a special package dedicated to building the default
	  filesystem image for the /etc/conf.d/ directory.
```

## package/getinge/fwupgrade/Config.in
```kconfig
config BR2_PACKAGE_FWUPGRADE
	bool "fwupgrade"
	# We need MTD at runtime, but these are not compile time
	# dependencies
	select BR2_PACKAGE_MTD
	select BR2_PACKAGE_MTD_FLASH_ERASE
	select BR2_PACKAGE_MTD_NANDWRITE
	help
         fwupgrade CGI script and utilities
```

## package/getinge/gpbr-tool/Config.in
```kconfig
config BR2_PACKAGE_GPBR_TOOL
	bool "gpbr-tool"
	help
         Tool to read/write GPBR registers.
```

## package/getinge/libagentembedded/Config.in
```kconfig
config BR2_PACKAGE_LIBAGENTEMBEDDED
	bool "libagentembedded"
	select BR2_PACKAGE_ZLIB
	select BR2_PACKAGE_EXPAT
	select BR2_PACKAGE_OPENSSL
```

## package/getinge/netcom-apps/Config.in
```kconfig
config BR2_PACKAGE_NETCOM_APPS
	bool "NetCOM applications"
	select BR2_PACKAGE_NETCOM_CGIC
	help
	  All NetCOM specific applications

if BR2_PACKAGE_NETCOM_APPS

config BR2_PACKAGE_NETCOM_APPS_AGS
        bool "ags"

config BR2_PACKAGE_NETCOM_APPS_DATABUFFERD
	bool "databufferd"

config BR2_PACKAGE_NETCOM_APPS_DEVCOMD
	bool "devcomd"

config BR2_PACKAGE_NETCOM_APPS_MODBUSD
	bool "modbusd"

config BR2_PACKAGE_NETCOM_APPS_NCLIC
	bool "nclic"

config BR2_PACKAGE_NETCOM_APPS_NCUTILD
	bool "ncutild"

config BR2_PACKAGE_NETCOM_APPS_NETCOMLOCATOR
	bool "netcomlocator"

config BR2_PACKAGE_NETCOM_APPS_PACS2000D
	bool "pacs2000d"

config BR2_PACKAGE_NETCOM_APPS_PACSBUFFERD
	bool "pacsbufferd"

config BR2_PACKAGE_NETCOM_APPS_PRINTLOGD
	bool "printlogd"

config BR2_PACKAGE_NETCOM_APPS_PRINTSCAND
	bool "printscand"

config BR2_PACKAGE_NETCOM_APPS_PRTUTIL
	bool "prtutil"

config BR2_PACKAGE_NETCOM_APPS_REMOTEAGENT
	bool "remoteAgent"

config BR2_PACKAGE_NETCOM_APPS_SERSRVD
	bool "sersrvd"

config BR2_PACKAGE_NETCOM_APPS_SNTPDATE
	bool "sntpdate"

config BR2_PACKAGE_NETCOM_APPS_WEBSETUP
	bool "websetup"

endif
```

## package/getinge/netcom-cgic/Config.in
```kconfig
config BR2_PACKAGE_NETCOM_CGIC
	bool "Special cgic library for NetCOM"
	help
	   This is a modified version of the cgic library for NetCOM
	   devices.
```

## package/getinge/netcom-web/Config.in
```kconfig
config BR2_PACKAGE_NETCOM_WEB
       bool "netcom web interface"
       select BR2_PACKAGE_FWUPGRADE
       help
         Getinge NetCOM Web interface
```

## package/getinge/respawnd/Config.in
```kconfig
config BR2_PACKAGE_RESPAWND
	bool "respawnd"
	help
         respawnd daemon and utilities.
```

## package/getinge/websetup/Config.in
```kconfig
config BR2_PACKAGE_WEBSETUP
	bool "websetup"
	help
	  CGI application to configure Getinge applications
```
